## boards/arm/nrf9160_ns/Kconfig.board
```kconfig
# Copyright (c) 2024 Nordic Semiconductor ASA
# SPDX-License-Identifier: Apache-2.0

config BOARD_NRF9160_NS
	bool "nrf9160_ns"
	depends on SOC_NRF9160_SICA
```

## boards/arm/nrf9160_ns/Kconfig.defconfig
```kconfig
# Copyright (c) 2024 Nordic Semiconductor ASA
# SPDX-License-Identifier: Apache-2.0

if BOARD_NRF9160_NS

config BOARD
	default "nrf9160_ns"


#Build with TF-M as the Secure Execution Environment
config BUILD_WITH_TFM
	default y
endif
```
